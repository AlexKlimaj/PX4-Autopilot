## src/drivers/optical_flow/paa3905/Kconfig
```kconfig
menuconfig DRIVERS_OPTICAL_FLOW_paa3905
	bool "paa3905"
	default n
	---help---
		Enable support for paa3905
```

## src/drivers/simple_can/Kconfig
```kconfig
menuconfig DRIVERS_SIMPLE_CAN
	bool "simple_can"
	default n
	---help---
		Enable support for simple_can
```

## src/drivers/teseo_gps/Kconfig
```kconfig
menuconfig DRIVERS_TESEO_GPS
	bool "teseo_gps"
	default n
	---help---
		Enable support for teseo GPS
```
